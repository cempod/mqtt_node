## components/sensor_aht20/Kconfig
```kconfig
menu "AHT20 sensor"

    config NODE_AHT20
        bool "Enable AHT20 temperature/humidity sensor"
        default n

    if NODE_AHT20

        config NODE_AHT20_I2C_PORT
            int "I2C port"
            range 0 1
            default 0

        config NODE_AHT20_SDA_PIN
            int "SDA GPIO"
            default 6

        config NODE_AHT20_SCL_PIN
            int "SCL GPIO"
            default 7

        config NODE_AHT20_I2C_FREQ_HZ
            int "I2C frequency (Hz)"
            default 100000

        config NODE_AHT20_INTERVAL_MS
            int "Publish interval (ms)"
            default 30000

    endif

endmenu
```

## main/Kconfig.projbuild
```kconfig
menu "MQTT node configuration"
    config MQTT_NODE_NAME
        string "Node name"
        default "MQTT node"
    config MQTT_BROKER_URI
        string "MQTT Broker URI"
        default "mqtts://192.168.1.100:8883"
    config ESP_WIFI_SSID
        string "Wi-Fi SSID"
        default "MySSID"
    config ESP_WIFI_PASSWORD
        string "Wi-Fi Password"
        default "MyPassword"
endmenu

menu "LED indicator"

    choice ESP_BOARD_LED_TYPE
        prompt "LED type"
        default ESP_BOARD_LED_TYPE_RGB

        config ESP_BOARD_LED_TYPE_NONE
            bool "No LED"

        config ESP_BOARD_LED_TYPE_RGB
            bool "Addressable RGB (WS2812)"

        config ESP_BOARD_LED_TYPE_GPIO
            bool "Plain GPIO LED"
    endchoice

    config ESP_BOARD_RGB_LED_PIN
        int "Addressable LED GPIO"
        depends on ESP_BOARD_LED_TYPE_RGB
        default 48

    config ESP_BOARD_GPIO_LED_PIN
        int "LED GPIO"
        depends on ESP_BOARD_LED_TYPE_GPIO
        default 8

    config ESP_BOARD_GPIO_LED_ACTIVE_LOW
        bool "LED is active-low"
        depends on ESP_BOARD_LED_TYPE_GPIO
        default n

    config ESP_BOARD_GPIO_LED_PWM
        bool "Use PWM (LEDC)"
        depends on ESP_BOARD_LED_TYPE_GPIO
        default y

endmenu
```
